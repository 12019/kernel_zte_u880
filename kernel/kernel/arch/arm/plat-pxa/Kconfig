## kernel/kernel/arch/arm/plat-pxa/Kconfig
```kconfig
if PLAT_PXA

source "arch/arm/plat-pxa/imm/Kconfig"

config PXA_VBUS
	tristate
	help
		Enable support for PXA VBUS

endif
```

## kernel/kernel/drivers/hwmon/lightsensor/Kconfig
```kconfig
config U810
	tristate "Sensors class support"
	default y
	help
	  Say Y here to enable sensors class support. This allows
	  user manipulate the sensors from sysfs interface.

config U810
         tristate "TSL2771 ALS/PS Driver"
         default y
         ---help---
           Say Y here if you want to enable tsl2771 ALS/PS  driver
```

## kernel/kernel/drivers/i2c/chips/Kconfig
```kconfig
#
# Miscellaneous I2C chip drivers configuration
#
# *** DEPRECATED! Do not add new entries! See Makefile ***
#

menu "Miscellaneous I2C Chip support"

config DS1682
	tristate "Dallas DS1682 Total Elapsed Time Recorder with Alarm"
	depends on EXPERIMENTAL
	help
	  If you say yes here you get support for Dallas Semiconductor
	  DS1682 Total Elapsed Time Recorder.

	  This driver can also be built as a module.  If so, the module
	  will be called ds1682.

config SENSORS_TSL2550
	tristate "Taos TSL2550 ambient light sensor"
	depends on EXPERIMENTAL
	help
	  If you say yes here you get support for the Taos TSL2550
	  ambient light sensor.

	  This driver can also be built as a module.  If so, the module
	  will be called tsl2550.

config SENSORS_PCA963X
	tristate "Philips PCA963X 4-bit I2C-bus LED"
	depends on I2C && EXPERIMENTAL
	help
	 If you say yes here you get support for the Philips PCA963X
	 4-bit I2C-bus LED.

	 This driver can also be built as a module.  If so, the module
	 will be called pca963X.

config TC358762
	boolean "TC358762 chip"
	depends on I2C && I2C_PXA
	default n
	help
	  If you say yes here, you support for it.

	  This driver can NOT be built as a module.

config SENSORS_AK8973
	tristate "AK8973"
	depends on I2C=y
	help
	  If you say yes here you get support for Asahi Kasei's 
	  orientation sensor AK8973.

config SENSORS_AK8962
	tristate "AK8962"
	depends on I2C=y
	help
	  If you say yes here you get support for Asahi Kasei's 
	  orientation sensor AK8962.

endmenu
```
